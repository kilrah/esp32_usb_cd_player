## components/jc1060p470_v2/Kconfig
```kconfig
menu "Board: Guition JC1060P470-V2"
    depends on IDF_TARGET_ESP32P4

    choice JC1060P470V2_AUDIO_OUT
        prompt "Audio output"
        default JC1060P470V2_AUDIO_PCM5102
        help
            Where the I2S audio goes.

        config JC1060P470V2_AUDIO_PCM5102
            bool "External PCM5102 DAC on the GPIO1-4 header (stereo)"
            help
                A PCM5102 module plugged straight onto the board's VCC/GND/GPIO1-4 header:
                VCC-VCC, GND-GND, GPIO1-LRCK, GPIO2-DIN, GPIO3-BCK, GPIO4-SCK (MCLK).
                The on-board speaker amplifier is kept off.

        config JC1060P470V2_AUDIO_ES8311
            bool "On-board ES8311 codec + speaker amplifier (mono)"
            help
                The board's ES8311 and NS4150 driving the speaker connector. The codec has a single DAC,
                so left and right are mixed.
    endchoice

endmenu
```

## components/s31_coreboard/Kconfig
```kconfig
menu "Board: ESP32-S31-Function-CoreBoard-1"
    depends on IDF_TARGET_ESP32S31

    choice S31CB_AUDIO_OUT
        prompt "Audio output"
        default S31CB_AUDIO_ES8311
        help
            Where the I2S audio goes.

        config S31CB_AUDIO_ES8311
            bool "On-board ES8311 codec + speaker amplifier (mono)"
            help
                The board's ES8311 and NS4150B driving the speaker connector. The codec has a single DAC,
                so left and right are mixed.

        config S31CB_AUDIO_PCM5102
            bool "External PCM5102 DAC on the J2 header (stereo)"
            help
                A PCM5102 module wired straight to the header: VCC, GND, GPIO25-LRCK, GPIO23-DIN,
                GPIO21-BCK, GPIO35-SCK (MCLK). The on-board speaker amplifier is kept off.
    endchoice

endmenu
```

## main/Kconfig.projbuild
```kconfig
menu "CD player"

    config CD_HOSTNAME
        string "Network hostname"
        default "cdplayer"
        help
            DHCP and mDNS hostname. The OTA server is reachable as http://<hostname>.local/.

    config CD_WIFI_SSID
        string "Default Wi-Fi SSID"
        default ""
        help
            Used only when no credentials are stored in NVS. Credentials set with the
            serial command 'W' are stored in NVS and take precedence. Empty = Wi-Fi off until set.

    config CD_WIFI_PASSWORD
        string "Default Wi-Fi password"
        default ""

    config CD_AP_PASSWORD
        string "Setup access point password"
        default "cdplayer"
        help
            WPA2 password of the setup access point (CDPlayer-XXXX, 192.168.4.1), which starts when no
            Wi-Fi network is configured or the configured one can't be reached. It is shown on the
            display while the AP is on. At least 8 characters; shorter = open network (not recommended:
            the web UI has no login and allows firmware uploads).

    config CD_META_CONTACT
        string "Contact for the MusicBrainz User-Agent"
        default ""
        help
            MusicBrainz asks API clients to identify themselves with "app/version ( contact )",
            e.g. a project URL or an e-mail address. Optional.

endmenu
```
